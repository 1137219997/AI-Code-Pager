## boards/arm/promicro_nrf52840/Kconfig.defconfig
```kconfig
if BOARD_PROMICRO_NRF52840

config BT_CTLR
    default BT

config NRF_RTC_TIMER
    default y

endif
```

## boards/arm/promicro_nrf52840/Kconfig.promicro_nrf52840
```kconfig
# ProMicro-compatible nRF52840 board configuration

# SPDX-License-Identifier: Apache-2.0

config BOARD_PROMICRO_NRF52840
	select SOC_NRF52840_QIAA
```

## boards/arm/promicro_nrf52840/promicro_nrf52840_defconfig
```kconfig
CONFIG_ARM_MPU=y
CONFIG_GPIO=y
CONFIG_SPI=y
CONFIG_BT=y
CONFIG_BT_CTLR=y
CONFIG_HW_STACK_PROTECTION=y
CONFIG_PINCTRL=y
CONFIG_USE_DT_CODE_PARTITION=y
```
